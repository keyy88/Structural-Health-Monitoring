#include <Arduino.h>
#include <driver/i2s.h>
// #include <TensorFlowLite_ESP32.h>
// #include "secret.h"
// #include "WiFi.h"
#include "ThingSpeak.h"

// Serial config
#define BAUDRATE    115200    // Baud rate

#define SECRET_SSID "Asus_Lab Instrumentasi"
#define SECRET_PASS "123456789"

#define SECRET_CH_ID 2260393
#define SECRET_WRITE_APIKEY "U1139IB2WTCO2TN7"

// Pulse config
#define PWM_PIN     5         // PWM pin
#define PWM_FREQ    5000      // PWM freq (Hz)
#define PWM_BITS    10        // PWM resolution
#define PWM_CHANNEL 0         // PWM Channel
#define PWM_DUTY    512       // PWM duty cycle
#define BURST_PULSE 1         // Pulse cycle count
#define DT          24000000  // Delay (1000ms)

//Interrupt pin
#define INT_PIN     18        // Interrupt pin (falling edge)

//ADC I2S configuration
#define I2S_SAMPLE_RATE     50000                             // Sampling freq ADC (Hz)
#define I2S_TS              (1000000/I2S_SAMPLE_RATE)         // Sampling time (us)
#define I2S_DMA_BUF_LEN     1024                              // I2S ADC buffer size
#define I2S_DMA_BUF_ARR     2                                 // I2S ADC buffer array size
#define I2S_DMA_BUF_FLATTEN (I2S_DMA_BUF_LEN*I2S_DMA_BUF_ARR) // Total buffer data size
#define ADC_INPUT           ADC1_CHANNEL_4                    // ADC Channel
#define VREF                3.3                               // ESP32 voltage reference
#define B_PASS_COEF         55                                // Band-pass filter coefficient size

size_t bytes_read;
uint8_t cnt;                                                  // Burst count
uint16_t buffer[I2S_DMA_BUF_ARR][I2S_DMA_BUF_LEN] = {0};
float buff[I2S_DMA_BUF_FLATTEN + (2 * B_PASS_COEF)] = {0};
float buff_filtered[I2S_DMA_BUF_FLATTEN] = {0.0};
unsigned long prev,curr;

// Feature extraction
#define FEATURE_EXTRACT
float miu, sigma_sqr;   // Mean and variance,
uint16_t tetha;         // Time of flight

// Thingspeak WiFi & API
#define IOT
char ssid[] = SECRET_SSID;                        //WiFi SSID
char pass[] = SECRET_PASS;                        //WiFi Password
unsigned long myChannelNumber = SECRET_CH_ID;     //Thingspeak CH ID
const char * myWriteAPIKey = SECRET_WRITE_APIKEY; //Thingspeak Write API key
// WiFiClient client;

// Neural network
#define NN
float dmg_index;

// Reference signal
const float ref_signal[I2S_DMA_BUF_FLATTEN]={-23.79,
-10.70,
3.64,
11.48,
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-0.00,
-0.00};

// Filter coefficient
const float bandpass_coef[B_PASS_COEF]= {0.000005886298855362,
                          -0.000003150867128908,
                          -0.000036667688162528,
                          -0.000040375108069883,
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                          -0.000003150867128906,
                           0.000005886298855359};

void IRAM_ATTR ISR()
{
  cnt++;
  if(cnt >= BURST_PULSE)
  {
    ledcWrite(PWM_CHANNEL,0);   
    cnt= 0;
  }
}

void i2sInit()
{
  i2s_config_t i2s_config =
  {
    .mode = (i2s_mode_t)(I2S_MODE_MASTER | I2S_MODE_RX | I2S_MODE_ADC_BUILT_IN),
    .sample_rate =  I2S_SAMPLE_RATE,              // The format of the signal using ADC_BUILT_IN
    .bits_per_sample = I2S_BITS_PER_SAMPLE_16BIT, // is fixed at 12bit, stereo, MSB
    .channel_format = I2S_CHANNEL_FMT_RIGHT_LEFT,
    .communication_format = I2S_COMM_FORMAT_STAND_I2S,
    .intr_alloc_flags = ESP_INTR_FLAG_LEVEL1,
    .dma_buf_count = 8,
    .dma_buf_len = I2S_DMA_BUF_LEN,
    .use_apll = false,
    .tx_desc_auto_clear = false,
    .fixed_mclk = 0
  };

  i2s_driver_install(I2S_NUM_0, &i2s_config, 0, NULL);
  i2s_set_adc_mode(ADC_UNIT_1, ADC_INPUT);
  adc1_config_channel_atten(ADC_INPUT, ADC_ATTEN_DB_11);
  i2s_adc_enable(I2S_NUM_0);
}

void setup()
{
  Serial.begin(BAUDRATE);
  cnt = 0;
  
  // PWM init
  ledcSetup(PWM_CHANNEL,PWM_FREQ,PWM_BITS);
  ledcAttachPin(PWM_PIN,PWM_CHANNEL);
  ledcWrite(PWM_CHANNEL,PWM_DUTY);

  // Interrupt init
  attachInterrupt(digitalPinToInterrupt(INT_PIN),ISR,FALLING);
  
  prev = ESP.getCycleCount();
  
  // WiFi & ThingSpeak init
  // WiFi.mode(WIFI_STA);
  // ThingSpeak.begin(client);

  // I2S ADC DMA init
  i2sInit();
}

void loop()
{
  // Connect or reconnect to WiFi
  // if(WiFi.status() != WL_CONNECTED)
  // {
  //   Serial.print("Attempting to connect to SSID: ");
  //   Serial.println(SECRET_SSID);
  //   while(WiFi.status() != WL_CONNECTED)
  //   {
  //     WiFi.begin(ssid, pass);  // Connect to WPA/WPA2 network. Change this line if using open or WEP network
  //     Serial.print(".");
  //     delay(5000);     
  //   } 
  //   Serial.println("\nConnected.");
  // }

  // Read ADC value
  for(int i = 0; i < I2S_DMA_BUF_ARR; i++)
  {
    i2s_read(I2S_NUM_0, &buffer[i], sizeof(buffer[i]), &bytes_read, portMAX_DELAY);
  }
  curr = ESP.getCycleCount();
  i2s_adc_disable(I2S_NUM_0);

  // Flatten 2 dimension array and convert into voltage
  for(int i = 0; i < I2S_DMA_BUF_ARR; i++)
  {
    for(int j = 0; j < (I2S_DMA_BUF_LEN + 0); j++)
    {
      buff[(i * I2S_DMA_BUF_LEN) + j] = map(buffer[i][j]&0x0fff, 0, 4095, (-1650), 1650);
    }
  }

  // Band-pass filter
  for(int i = 0; i < I2S_DMA_BUF_FLATTEN; i++)
  {
    float conv = 0;
    for(int j = 0; j < B_PASS_COEF; j++) conv += buff[i+j] * bandpass_coef[j];
    buff_filtered[i] = conv;
  }

  // Feature extraction
  #ifdef FEATURE_EXTRACT
    // Peak
    int peak = 0;
    for(int i = 0; i < I2S_DMA_BUF_FLATTEN; i++)
    {
      if(abs(buff[i]) > peak) peak = buff[i];
    }
   
    // Mean
    float sum = 0;
    for(int i = 0; i < I2S_DMA_BUF_FLATTEN; i++) sum += buff[i];
    miu = (float)(sum/I2S_DMA_BUF_FLATTEN);

    // Variance
    sum = 0;
    for(int i = 0; i < I2S_DMA_BUF_FLATTEN; i++) sum += pow(buff[i] - miu, 2);
    sigma_sqr = (float)(sum/I2S_DMA_BUF_FLATTEN);

    // Time of Flight
    int n = 0;
    float tmp = 0;
    for(int i = 0; i < I2S_DMA_BUF_FLATTEN; i++)
    {
      sum = 0;
      for(int j = 0; j < I2S_DMA_BUF_FLATTEN; j++)
      {
        if((i + j) < I2S_DMA_BUF_FLATTEN) sum += buff_filtered[j] * ref_signal[i + j];

        if(sum > tmp)
        {
          tmp = sum;
          n = i;
        }
      }
    }
    tetha = (n * I2S_TS);

    // Print parameter
    Serial.printf("peak;%d;mean;%.2f;var;%.2f;tof;%d\n", peak, miu, sigma_sqr, tetha);
    
    // #ifdef IOT
    //   ThingSpeak.setField(1, peak);
    //   ThingSpeak.setField(2, miu);
    //   ThingSpeak.setField(3, sigma_sqr);
    //   ThingSpeak.setField(4, tetha);
    //   // ThingSpeak.setField(5, dmg_index);

    //   int x = ThingSpeak.writeFields(myChannelNumber, myWriteAPIKey);

    //   // if(x == 200) Serial.println("Channel update successful.");
    //   // else Serial.println("Problem updating channel. HTTP error code " + String(x));
    // #endif
  #endif

  // Print features
  Serial.printf("peak;%d;mean;%.f;variance;%.f;tof;%d", peak, miu, sigma_sqr, tetha);

  // Print signal
  for(int i = 0; i < I2S_DMA_BUF_FLATTEN; i++)
  {
    Serial.printf("%.2f\n", (buff_filtered[i]));
  }

  delay(1000);
  prev = ESP.getCycleCount();
  i2s_adc_enable(I2S_NUM_0);
  ledcWrite(PWM_CHANNEL, PWM_DUTY);
}